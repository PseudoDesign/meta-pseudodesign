## conf/distro/pseudodesign-dev.conf
```bitbake
# Distro Layer configuration
# include and overwrite default poky distro
include conf/distro/poky.conf
DISTRO = "pseudodesign-dev"
DISTRO_NAME = "PseudoDesign-Dev-Linux"
DISTRO_VERSION = "0.0.1"
DISTRO_CODENAME = "Isaac"
SDK_VENDOR = "-pseudodesign-dev-sdk"
SDK_VERSION="${DISTRO_VERSION}"
MAINTAINER = "info@pseudo.design"

TARGET_VENDOR = "-pseudodesign-dev"

# Override these in poky based distros
PSEUDODESIGN_DEV_DEFAULT_EXTRA_RDEPENDS = "packagegroup-pseudodesign tools-debug"
PSEUDODESIGN_DEV_DEFAULT_EXTRA_RRECOMMENDS = ""

DISTRO_EXTRA_RDEPENDS += " ${MYDISTRO_DEFAULT_EXTRA_RDEPENDS}"
DISTRO_EXTRA_RRECOMMENDS += " ${MYDISTO_DEFAULT_EXTRA_RRECOMMENDS}"

# Use systemd as init manager
DISTRO_FEATURES_append = " systemd"
VIRTUAL-RUNTIME_init_manager = "systemd"
DISTRO_FEATURES_BACKFILL_CONSIDERED = "sysvinit"
VIRTUAL-RUNTIME_initscripts = ""
```

## conf/distro/pseudodesign.conf
```bitbake
# Distro Layer configuration
# include and overwrite default poky distro
include conf/distro/poky.conf
DISTRO = "pseudodesign"
DISTRO_NAME = "PseudoDesign-Linux"
DISTRO_VERSION = "0.0.1"
DISTRO_CODENAME = "Isaac"
SDK_VENDOR = "-pseudodesign-sdk"
SDK_VERSION="${DISTRO_VERSION}"
MAINTAINER = "info@pseudo.design"

TARGET_VENDOR = "-pseudodesign"

# Override these in poky based distros
PSEUDODESIGN_DEV_DEFAULT_EXTRA_RDEPENDS = "packagegroup-pseudodesign"
PSEUDODESIGN_DEV_DEFAULT_EXTRA_RRECOMMENDS = ""

DISTRO_EXTRA_RDEPENDS += " ${PSEUDODESIGN_DEV_DEFAULT_EXTRA_RDEPENDS}"
#DISTRO_EXTRA_RRECOMMENDS += " ${PSUEDODESIGN_DEV_DEFAULT_EXTRA_RRECOMMENDS}"

# Use systemd as init manager
DISTRO_FEATURES_append = " systemd"
VIRTUAL-RUNTIME_init_manager = "systemd"
DISTRO_FEATURES_BACKFILL_CONSIDERED = "sysvinit"
VIRTUAL-RUNTIME_initscripts = ""
```

## conf/layer.conf
```bitbake
# We have a conf and classes directory, add to BBPATH
BBPATH .= ":${LAYERDIR}"

# We have recipes-* directories, add to BBFILES
BBFILES += "${LAYERDIR}/recipes-*/*/*.bb \
	${LAYERDIR}/recipes-*/*/*.bbappend"

BBFILE_COLLECTIONS += "pseudodesign"
BBFILE_PATTERN_pseudodesign = "^${LAYERDIR}/"
BBFILE_PRIORITY_pseudodesign = "6"
```
